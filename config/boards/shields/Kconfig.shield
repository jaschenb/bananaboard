## config/boards/shields/Kconfig.shield
```kconfig
config SHIELD_BANANABOARD_LEFT
    def_bool $(shields_list_contains,bananaboard_left)

config SHIELD_BANANABOARD_RIGHT
    def_bool $(shields_list_contains,bananaboard_right)
```

## config/boards/shields/bananaboard/Kconfig.defconfig
```kconfig
if SHIELD_BANANABOARD_LEFT

config ZMK_KEYBOARD_NAME
    default "Bananaboard"

config ZMK_SPLIT_ROLE_CENTRAL
    bool
    default y

endif

if SHIELD_BANANABOARD_LEFT || SHIELD_BANANABOARD_RIGHT

config ZMK_SPLIT
    bool
    default y

endif
```

## config/west.yml
```yaml
manifest:
  remotes:
    - name: zmkfirmware
      url-base: https://github.com/zmkfirmware
    - name: jaschenb
      url-base: https://github.com/jaschenb
  projects:
    - name: zmk
      remote: zmkfirmware
      revision: main
      import: app/west.yml
  self:
    path: config
```
